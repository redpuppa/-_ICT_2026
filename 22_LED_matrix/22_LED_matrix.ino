/*
  예제 22. 내장 LED 매트릭스 직접 제어 (찰리플렉싱) - 짝수/홀수 열 교대
  - 매트릭스는 11핀(D28~D38)으로 96개 LED(12열 x 8행)를 구동
  - 찰리플렉싱은 한 번에 한 개만 켤 수 있으므로, 한 열 그룹(48개)을
    100ms 동안 빠르게 멀티플렉싱하여 "다 켜진 것처럼" 보이게 한다.
  - 이 예제: 짝수 열(0,2,4,6,8,10) 100ms → 홀수 열(1,3,5,7,9,11) 100ms, 반복

  ※ pins[][2] = 각 LED의 {애노드 오프셋, 캐소드 오프셋}
    실제 아두이노 핀 번호 = 오프셋 + 28 (D28~D38)
    (Arduino_LED_Matrix 라이브러리의 매핑표와 동일)

  ※ 좌표(x,y) → LED 인덱스 변환 (라이브러리 프레임버퍼 규칙에서 도출):
     j = y*12 + x         // 캔버스 선형 인덱스 (행 우선)
     i = 32*(j/32) + 31 - (j%32)   // 32개 블록마다 순서가 뒤집힌다
*/

const int PIN_BASE = 28;   // 오프셋 0 → D28

const uint8_t pins[96][2] = {
  {7,3},{3,7},{7,4},{4,7},{3,4},{4,3},{7,8},{8,7},{3,8},{8,3},   // 0~9
  {4,8},{8,4},{7,0},{0,7},{3,0},{0,3},{4,0},{0,4},{8,0},{0,8},   // 10~19
  {7,6},{6,7},{3,6},{6,3},{4,6},{6,4},{8,6},{6,8},{0,6},{6,0},   // 20~29
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  {7,9},{9,7},{3,9},{9,3},{4,9},{9,4}                            // 90~95
};

// 매트릭스 11핀(D28~D38)을 모두 입력(하이임피던스)으로 → 전류 경로 차단
void allInput() {
  for (int p = PIN_BASE; p <= PIN_BASE + 10; p++) {
    pinMode(p, INPUT);
  }
}

// 인덱스로 지정한 LED 한 개만 점등
void lightLed(int idx) {
  allInput();                                   // 먼저 전부 차단
  int high = pins[idx][0] + PIN_BASE;           // 애노드
  int low  = pins[idx][1] + PIN_BASE;           // 캐소드
  pinMode(high, OUTPUT); digitalWrite(high, HIGH);
  pinMode(low,  OUTPUT); digitalWrite(low,  LOW);
}

// 격자 좌표 (x=열 0~11, y=행 0~7) → LED 인덱스
int ledIndexAt(int x, int y) {
  int j = y * 12 + x;                    // 캔버스 선형 인덱스 (행 우선)
  return 32 * (j / 32) + 31 - (j % 32);  // 32개 블록마다 순서 반전
}

// parity(0=짝수 열, 1=홀수 열)에 해당하는 열들을 durationMs 동안 멀티플렉싱
void showColumns(int parity, unsigned long durationMs) {
  unsigned long t0 = millis();
  while (millis() - t0 < durationMs) {
    for (int x = parity; x < 12; x += 2) {   // 짝수 또는 홀수 열
      for (int y = 0; y < 8; y++) {          // 해당 열의 8개 행
        lightLed(ledIndexAt(x, y));
        delayMicroseconds(200);              // 각 LED 점등 시간
      }
    }
  }
  allInput();                                // 그룹 끝나면 소등
}

void setup() {
  allInput();
}

void loop() {
  showColumns(0, 100);   // 짝수 열(0,2,4,6,8,10) 100ms
  showColumns(1, 100);   // 홀수 열(1,3,5,7,9,11) 100ms
}
